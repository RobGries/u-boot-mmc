/*
 * U-Boot addition to handle Dragonboard 410c pins
 *
 * (C) Copyright 2015 Mateusz Kulikowski <mateusz.kulikowski@gmail.com>
 *
 * SPDX-License-Identifier:	GPL-2.0+
 */

/ {
	config {
		u-boot,mmc-env-partition = "boot";
	};
};


&pm8916_gpios {
	usb_hub_reset_pm {
		gpios = <&pm8916_gpios 2 0>;
	};

	usb_sw_sel_pm {
		gpios = <&pm8916_gpios 3 0>;
	};
};


&pm8916_pon {
	key_vol_down {
		gpios = <&pm8916_pon 1 0>;
	};

	key_power {
		gpios = <&pm8916_pon 0 0>;
	};
};

leds {
	compatible = "gpio-leds";
	led@1 {
		label = "miku-red-led";
		gpios = <&soc_gpios 21 0>;
		default-state = "on";
	};
	led@2 {
		label = "miku-blue-led";
		gpios = <&soc_gpios 22 0>;
		default-state = "on";
	};
	led@3 {
		label = "miku-green-led";
		gpios = <&soc_gpios 23 0>;
		default-state = "on";
	};
};

